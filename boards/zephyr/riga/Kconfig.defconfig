## boards/zephyr/riga/Kconfig.defconfig
```kconfig
# STM32F0 development board with STM32F051R8T6 MCU

# Copyright (c) 2018 Nathan Tsoi <nathan@vertile.com>
# SPDX-License-Identifier: Apache-2.0

if BOARD_RIGA

config BOARD
	default "riga"

endif # BOARD_RIGA
```

## boards/zephyr/rijeka/Kconfig.board
```kconfig
# STM32H743ZI Nucleo board configuration

# Copyright (c) 2020 Teslabs Engineering S.L.
# SPDX-License-Identifier: Apache-2.0

config BOARD_RIJEKA
	bool "Nucleo H743ZI Development Board #2"
	depends on SOC_STM32H743XX
```

## boards/zephyr/rijeka/Kconfig.defconfig
```kconfig
# STM32H743ZI Nucleo board configuration

# Copyright (c) 2020 Teslabs Engineering S.L.
# SPDX-License-Identifier: Apache-2.0

if BOARD_RIJEKA

config BOARD
	default "rijeka"

if NETWORKING

config NET_L2_ETHERNET
	default y

endif # NETWORKING

endif # BOARD_RIJEKA
```
